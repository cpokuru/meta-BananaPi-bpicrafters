## conf/layer.conf
```bitbake
# We have a conf and classes directory, add to BBPATH
BBPATH .= ":${LAYERDIR}"

# We have a recipes-* directories, add to BBFILES
BBFILES += "${LAYERDIR}/recipes-*/*/*.bb \
	${LAYERDIR}/recipes-*/*/*.bbappend"

BBFILE_COLLECTIONS += "BananaPi"
BBFILE_PATTERN_BananaPi = "^${LAYERDIR}/"
BBFILE_PRIORITY_BananaPi = "24"

LAYERSERIES_COMPAT_BananaPi = "dunfell kirkstone"

require conf/distro/include/rdk-filogic.inc
#require conf/include/rdk-external-src-platform.inc
```
